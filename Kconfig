## Kconfig
```kconfig
# ZMK Smoothstepスクロール軸スナップ設定

config ZMK_INPUT_PROCESSOR_SMOOTHSTEP_AXIS_SNAP
    bool "Smoothstep方式のスクロール軸スナップ処理"
    default n
    depends on ZMK_POINTING
    help
      スクロールの動きをSmoothstep方式で滑らかに軸方向にスナップする
      入力プロセッサーを有効にします。

if ZMK_INPUT_PROCESSOR_SMOOTHSTEP_AXIS_SNAP

config ZMK_INPUT_PROCESSOR_SMOOTHSTEP_AXIS_SNAP_DEFAULT_THRESHOLD_START
    int "軸スナップ開始閾値"
    default 150
    range 50 300
    help
      軸比率がこの値以下だと完全にスナップし、この値から終了閾値までの範囲で
      滑らかに遷移します。単位は1000分率で、150は15%を意味します。

config ZMK_INPUT_PROCESSOR_SMOOTHSTEP_AXIS_SNAP_DEFAULT_THRESHOLD_END
    int "軸スナップ終了閾値"
    default 350
    range 200 500
    help
      軸比率がこの値以上だと全く減衰せず、開始閾値からこの値までの範囲で
      滑らかに遷移します。単位は1000分率で、350は35%を意味します。

endif # ZMK_INPUT_PROCESSOR_SMOOTHSTEP_AXIS_SNAP
```

## dts/bindings/zmk,input-processor-smoothstep-axis-snap.yaml
```yaml
# Copyright (c) 2025 yamaryu211
# SPDX-License-Identifier: MIT

description: Smoothstep軸スナップ入力プロセッサー - スクロール専用

compatible: "zmk,input-processor-smoothstep-axis-snap"

include: input-processor.yaml

properties:
  threshold-start:
    type: int
    default: 150
    description: |
      軸スナップの開始閾値。
      軸比率がこの値以下だと完全にスナップし、この値から終了閾値までの範囲で
      滑らかに遷移します。単位は1000分率で、150は15%を意味します。

  threshold-end:
    type: int
    default: 350
    description: |
      軸スナップの終了閾値。
      軸比率がこの値以上だと全く減衰せず、開始閾値からこの値までの範囲で
      滑らかに遷移します。単位は1000分率で、350は35%を意味します。
```
